## config/boards/shields/guppy/Kconfig.shield
```kconfig
# Copyright (c) 2021 The ZMK Contributors
# SPDX-License-Identifier: MIT

config SHIELD_GUPPY_LEFT
    def_bool $(shields_list_contains,guppy_left)
config SHIELD_GUPPY_RIGHT
    def_bool $(shields_list_contains,guppy_right)
```

## config/boards/shields/tinkerball/Kconfig.defconfig
```kconfig
if SHIELD_TINKERBALL_RIGHT

config ZMK_KEYBOARD_NAME
	default "Tinkerball"

config ZMK_SPLIT_BLE_ROLE_CENTRAL
	default y

endif

if SHIELD_TINKERBALL_LEFT || SHIELD_TINKERBALL_RIGHT

config ZMK_SPLIT
	default y
	
endif

config MOUSE_LAYER_INDEX
	int "Index of mouse layer"
	default 4

config SCROLL_LAYER_INDEX
	int "Index of scroll layer"
	default 5

config MOUSE_LAYER_ACTIVE_MS
	int "Amount of milliseconds the mouse layer will be active after using the trackball"
	default 400
```

## config/boards/shields/tinkerball/Kconfig.shield
```kconfig
config SHIELD_TINKERBALL_LEFT
	def_bool $(shields_list_contains,tinkerball_left)

config SHIELD_TINKERBALL_RIGHT
	def_bool $(shields_list_contains,tinkerball_right)
```

## config/west.yml
```yaml
manifest:
  remotes:
    - name: zmkfirmware
      url-base: https://github.com/zmkfirmware
    - name: od
      url-base: https://github.com/olidacombe
    - name: void
      url-base: https://github.com/victorlucachi
  projects:
    - name: zmk
      remote: od
      revision: void_pmw3610-aml
      import: app/west.yml
  self:
    path: config
```

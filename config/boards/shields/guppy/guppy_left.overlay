#include "guppy.dtsi"
#include <dt-bindings/zmk/trackball_pim447.h>

&kscan0 {
    col-gpios
        = <&pro_micro_a 3 GPIO_ACTIVE_HIGH>
        , <&pro_micro_a 2 GPIO_ACTIVE_HIGH>
        , <&pro_micro_a 1 GPIO_ACTIVE_HIGH>
        , <&pro_micro_a 0 GPIO_ACTIVE_HIGH>
        , <&pro_micro_d 15 GPIO_ACTIVE_HIGH>
        ;
};

&left_encoder {
    status = "okay";
};

&pro_micro_i2c {
	status = "okay";

	trackball_pim447@a {
		compatible = "pimoroni,trackball_pim447";
		reg = <0xa>;
		label = "TRACKBALL_PIM447";
		move-factor = <2>;
		int-gpios = <&pro_micro_d 14 (GPIO_ACTIVE_LOW | GPIO_PULL_UP)>;
	};
};
